## build/Kconfig/Kconfig.modules
```kconfig
menu "acpica (/Users/sandviklee/Desktop/Repositories/sandviklee/spinsat/modules/lib/acpica)"
osource "$(ZEPHYR_ACPICA_KCONFIG)"
config ZEPHYR_ACPICA_MODULE
	bool
	default y
endmenu
menu "cmsis (/Users/sandviklee/Desktop/Repositories/sandviklee/spinsat/modules/hal/cmsis)"
osource "$(ZEPHYR_CMSIS_KCONFIG)"
config ZEPHYR_CMSIS_MODULE
	bool
	default y
endmenu
menu "cmsis-dsp (/Users/sandviklee/Desktop/Repositories/sandviklee/spinsat/modules/lib/cmsis-dsp)"
osource "$(ZEPHYR_CMSIS_DSP_KCONFIG)"
config ZEPHYR_CMSIS_DSP_MODULE
	bool
	default y
endmenu
menu "cmsis-nn (/Users/sandviklee/Desktop/Repositories/sandviklee/spinsat/modules/lib/cmsis-nn)"
osource "$(ZEPHYR_CMSIS_NN_KCONFIG)"
config ZEPHYR_CMSIS_NN_MODULE
	bool
	default y
endmenu
menu "fatfs (/Users/sandviklee/Desktop/Repositories/sandviklee/spinsat/modules/fs/fatfs)"
osource "$(ZEPHYR_FATFS_KCONFIG)"
config ZEPHYR_FATFS_MODULE
	bool
	default y
endmenu
config ZEPHYR_ADI_MODULE
	bool
	default y
config ZEPHYR_ALTERA_MODULE
	bool
	default y
menu "hal_ambiq (/Users/sandviklee/Desktop/Repositories/sandviklee/spinsat/modules/hal/ambiq)"
osource "$(ZEPHYR_HAL_AMBIQ_KCONFIG)"
config ZEPHYR_HAL_AMBIQ_MODULE
	bool
	default y
endmenu
config ZEPHYR_ATMEL_MODULE
	bool
	default y
menu "hal_espressif (/Users/sandviklee/Desktop/Repositories/sandviklee/spinsat/modules/hal/espressif)"
osource "/Users/sandviklee/Desktop/Repositories/sandviklee/spinsat/modules/hal/espressif/zephyr/Kconfig"
config ZEPHYR_HAL_ESPRESSIF_MODULE
	bool
	default y

config ZEPHYR_HAL_ESPRESSIF_MODULE_BLOBS
	bool
endmenu
menu "hal_ethos_u (/Users/sandviklee/Desktop/Repositories/sandviklee/spinsat/modules/hal/ethos_u)"
osource "$(ZEPHYR_HAL_ETHOS_U_KCONFIG)"
config ZEPHYR_HAL_ETHOS_U_MODULE
	bool
	default y
endmenu
menu "hal_gigadevice (/Users/sandviklee/Desktop/Repositories/sandviklee/spinsat/modules/hal/gigadevice)"
osource "$(ZEPHYR_HAL_GIGADEVICE_KCONFIG)"
config ZEPHYR_HAL_GIGADEVICE_MODULE
	bool
	default y
endmenu
menu "hal_infineon (/Users/sandviklee/Desktop/Repositories/sandviklee/spinsat/modules/hal/infineon)"
osource "$(ZEPHYR_HAL_INFINEON_KCONFIG)"
config ZEPHYR_HAL_INFINEON_MODULE
	bool
	default y

config ZEPHYR_HAL_INFINEON_MODULE_BLOBS
	bool
endmenu
menu "hal_intel (/Users/sandviklee/Desktop/Repositories/sandviklee/spinsat/modules/hal/intel)"
osource "/Users/sandviklee/Desktop/Repositories/sandviklee/spinsat/modules/hal/intel/zephyr/Kconfig"
config ZEPHYR_HAL_INTEL_MODULE
	bool
	default y
endmenu
config ZEPHYR_MICROCHIP_MODULE
	bool
	default y
menu "hal_nordic (/Users/sandviklee/Desktop/Repositories/sandviklee/spinsat/modules/hal/nordic)"
osource "$(ZEPHYR_HAL_NORDIC_KCONFIG)"
config ZEPHYR_HAL_NORDIC_MODULE
	bool
	default y

config ZEPHYR_HAL_NORDIC_MODULE_BLOBS
	bool
endmenu
config ZEPHYR_NUVOTON_MODULE
	bool
	default y
menu "hal_nxp (/Users/sandviklee/Desktop/Repositories/sandviklee/spinsat/modules/hal/nxp)"
osource "$(ZEPHYR_HAL_NXP_KCONFIG)"
config ZEPHYR_HAL_NXP_MODULE
	bool
	default y

config ZEPHYR_HAL_NXP_MODULE_BLOBS
	bool
endmenu
config ZEPHYR_OPENISA_MODULE
	bool
	default y
config ZEPHYR_QUICKLOGIC_MODULE
	bool
	default y
config ZEPHYR_HAL_RENESAS_MODULE
	bool
	default y

config ZEPHYR_HAL_RENESAS_MODULE_BLOBS
	bool
menu "hal_rpi_pico (/Users/sandviklee/Desktop/Repositories/sandviklee/spinsat/modules/hal/rpi_pico)"
osource "$(ZEPHYR_HAL_RPI_PICO_KCONFIG)"
config ZEPHYR_HAL_RPI_PICO_MODULE
	bool
	default y
endmenu
menu "hal_st (/Users/sandviklee/Desktop/Repositories/sandviklee/spinsat/modules/hal/st)"
osource "$(ZEPHYR_HAL_ST_KCONFIG)"
config ZEPHYR_HAL_ST_MODULE
	bool
	default y
endmenu
config ZEPHYR_HAL_STM32_MODULE
	bool
	default y

config ZEPHYR_HAL_STM32_MODULE_BLOBS
	bool
menu "hal_tdk (/Users/sandviklee/Desktop/Repositories/sandviklee/spinsat/modules/hal/tdk)"
osource "$(ZEPHYR_HAL_TDK_KCONFIG)"
config ZEPHYR_HAL_TDK_MODULE
	bool
	default y
endmenu
menu "hal_telink (/Users/sandviklee/Desktop/Repositories/sandviklee/spinsat/modules/hal/telink)"
osource "/Users/sandviklee/Desktop/Repositories/sandviklee/spinsat/modules/hal/telink/Kconfig"
config ZEPHYR_HAL_TELINK_MODULE
	bool
	default y
endmenu
config ZEPHYR_TI_MODULE
	bool
	default y
menu "hal_wch (/Users/sandviklee/Desktop/Repositories/sandviklee/spinsat/modules/hal/wch)"
osource "$(ZEPHYR_HAL_WCH_KCONFIG)"
config ZEPHYR_HAL_WCH_MODULE
	bool
	default y
endmenu
config ZEPHYR_HAL_WURTHELEKTRONIK_MODULE
	bool
	default y
config ZEPHYR_XTENSA_MODULE
	bool
	default y
menu "hostap (/Users/sandviklee/Desktop/Repositories/sandviklee/spinsat/modules/lib/hostap)"
osource "$(ZEPHYR_HOSTAP_KCONFIG)"
config ZEPHYR_HOSTAP_MODULE
	bool
	default y
endmenu
menu "liblc3 (/Users/sandviklee/Desktop/Repositories/sandviklee/spinsat/modules/lib/liblc3)"
osource "$(ZEPHYR_LIBLC3_KCONFIG)"
config ZEPHYR_LIBLC3_MODULE
	bool
	default y
endmenu
config ZEPHYR_LIBMCTP_MODULE
	bool
	default y
config ZEPHYR_LIBMETAL_MODULE
	bool
	default y
menu "littlefs (/Users/sandviklee/Desktop/Repositories/sandviklee/spinsat/modules/fs/littlefs)"
osource "$(ZEPHYR_LITTLEFS_KCONFIG)"
config ZEPHYR_LITTLEFS_MODULE
	bool
	default y
endmenu
menu "loramac-node (/Users/sandviklee/Desktop/Repositories/sandviklee/spinsat/modules/lib/loramac-node)"
osource "$(ZEPHYR_LORAMAC_NODE_KCONFIG)"
config ZEPHYR_LORAMAC_NODE_MODULE
	bool
	default y
endmenu
menu "lvgl (/Users/sandviklee/Desktop/Repositories/sandviklee/spinsat/modules/lib/gui/lvgl)"
osource "/Users/sandviklee/Desktop/Repositories/sandviklee/spinsat/modules/lib/gui/lvgl/zephyr/Kconfig"
config ZEPHYR_LVGL_MODULE
	bool
	default y
endmenu
menu "mbedtls (/Users/sandviklee/Desktop/Repositories/sandviklee/spinsat/modules/crypto/mbedtls)"
osource "$(ZEPHYR_MBEDTLS_KCONFIG)"
config ZEPHYR_MBEDTLS_MODULE
	bool
	default y
endmenu
config ZEPHYR_MCUBOOT_MODULE
	bool
	default y
config ZEPHYR_MIPI_SYS_T_MODULE
	bool
	default y
menu "nrf_wifi (/Users/sandviklee/Desktop/Repositories/sandviklee/spinsat/modules/lib/nrf_wifi)"
osource "$(ZEPHYR_NRF_WIFI_KCONFIG)"
config ZEPHYR_NRF_WIFI_MODULE
	bool
	default y

config ZEPHYR_NRF_WIFI_MODULE_BLOBS
	bool
endmenu
config ZEPHYR_OPEN_AMP_MODULE
	bool
	default y
menu "openthread (/Users/sandviklee/Desktop/Repositories/sandviklee/spinsat/modules/lib/openthread)"
osource "$(ZEPHYR_OPENTHREAD_KCONFIG)"
config ZEPHYR_OPENTHREAD_MODULE
	bool
	default y
endmenu
menu "percepio (/Users/sandviklee/Desktop/Repositories/sandviklee/spinsat/modules/debug/percepio)"
osource "/Users/sandviklee/Desktop/Repositories/sandviklee/spinsat/modules/debug/percepio/zephyr/Kconfig"
config ZEPHYR_PERCEPIO_MODULE
	bool
	default y
endmenu
menu "picolibc (/Users/sandviklee/Desktop/Repositories/sandviklee/spinsat/modules/lib/picolibc)"
osource "/Users/sandviklee/Desktop/Repositories/sandviklee/spinsat/modules/lib/picolibc/zephyr/Kconfig"
config ZEPHYR_PICOLIBC_MODULE
	bool
	default y
endmenu
menu "segger (/Users/sandviklee/Desktop/Repositories/sandviklee/spinsat/modules/debug/segger)"
osource "$(ZEPHYR_SEGGER_KCONFIG)"
config ZEPHYR_SEGGER_MODULE
	bool
	default y
endmenu
config ZEPHYR_TINYCRYPT_MODULE
	bool
	default y
menu "trusted-firmware-a (/Users/sandviklee/Desktop/Repositories/sandviklee/spinsat/modules/tee/tf-a/trusted-firmware-a)"
osource "$(ZEPHYR_TRUSTED_FIRMWARE_A_KCONFIG)"
config ZEPHYR_TRUSTED_FIRMWARE_A_MODULE
	bool
	default y
endmenu
menu "trusted-firmware-m (/Users/sandviklee/Desktop/Repositories/sandviklee/spinsat/modules/tee/tf-m/trusted-firmware-m)"
osource "$(ZEPHYR_TRUSTED_FIRMWARE_M_KCONFIG)"
config ZEPHYR_TRUSTED_FIRMWARE_M_MODULE
	bool
	default y
endmenu
menu "uoscore-uedhoc (/Users/sandviklee/Desktop/Repositories/sandviklee/spinsat/modules/lib/uoscore-uedhoc)"
osource "$(ZEPHYR_UOSCORE_UEDHOC_KCONFIG)"
config ZEPHYR_UOSCORE_UEDHOC_MODULE
	bool
	default y
endmenu
menu "zcbor (/Users/sandviklee/Desktop/Repositories/sandviklee/spinsat/modules/lib/zcbor)"
osource "$(ZEPHYR_ZCBOR_KCONFIG)"
config ZEPHYR_ZCBOR_MODULE
	bool
	default y
endmenu
config ZEPHYR_NRF_HW_MODELS_MODULE
	bool
	default y
```

## build/Kconfig/arch/Kconfig
```kconfig
# Load Zephyr Arch Kconfig descriptions.
osource "/Users/sandviklee/Desktop/Repositories/sandviklee/spinsat/zephyr/arch/x86/Kconfig"
osource "/Users/sandviklee/Desktop/Repositories/sandviklee/spinsat/zephyr/arch/xtensa/Kconfig"
osource "/Users/sandviklee/Desktop/Repositories/sandviklee/spinsat/zephyr/arch/sparc/Kconfig"
osource "/Users/sandviklee/Desktop/Repositories/sandviklee/spinsat/zephyr/arch/riscv/Kconfig"
osource "/Users/sandviklee/Desktop/Repositories/sandviklee/spinsat/zephyr/arch/posix/Kconfig"
osource "/Users/sandviklee/Desktop/Repositories/sandviklee/spinsat/zephyr/arch/nios2/Kconfig"
osource "/Users/sandviklee/Desktop/Repositories/sandviklee/spinsat/zephyr/arch/mips/Kconfig"
osource "/Users/sandviklee/Desktop/Repositories/sandviklee/spinsat/zephyr/arch/arm64/Kconfig"
osource "/Users/sandviklee/Desktop/Repositories/sandviklee/spinsat/zephyr/arch/arm/Kconfig"
osource "/Users/sandviklee/Desktop/Repositories/sandviklee/spinsat/zephyr/arch/arc/Kconfig"
```

## build/Kconfig/boards/Kconfig
```kconfig
# Load Zephyr board Kconfig descriptions.
osource "/Users/sandviklee/Desktop/Repositories/sandviklee/spinsat/zephyr/boards/native/native_posix/Kconfig"
```

## build/Kconfig/boards/Kconfig.defconfig
```kconfig
# Load Zephyr board defconfig descriptions.
osource "/Users/sandviklee/Desktop/Repositories/sandviklee/spinsat/zephyr/boards/native/native_posix/Kconfig.defconfig"
```
