## build/Kconfig/soc/Kconfig
```kconfig
# Load Zephyr SoC Kconfig descriptions.
osource "/Users/sandviklee/Desktop/Repositories/sandviklee/spinsat/zephyr/soc/xlnx/zynqmp/Kconfig"
osource "/Users/sandviklee/Desktop/Repositories/sandviklee/spinsat/zephyr/soc/xlnx/zynq7000/Kconfig"
osource "/Users/sandviklee/Desktop/Repositories/sandviklee/spinsat/zephyr/soc/xen/Kconfig"
osource "/Users/sandviklee/Desktop/Repositories/sandviklee/spinsat/zephyr/soc/wch/ch32v/Kconfig"
osource "/Users/sandviklee/Desktop/Repositories/sandviklee/spinsat/zephyr/soc/ti/simplelink/Kconfig"
osource "/Users/sandviklee/Desktop/Repositories/sandviklee/spinsat/zephyr/soc/ti/lm3s6965/Kconfig"
osource "/Users/sandviklee/Desktop/Repositories/sandviklee/spinsat/zephyr/soc/ti/k3/Kconfig"
osource "/Users/sandviklee/Desktop/Repositories/sandviklee/spinsat/zephyr/soc/telink/tlsr/Kconfig"
osource "/Users/sandviklee/Desktop/Repositories/sandviklee/spinsat/zephyr/soc/starfive/jh71xx/Kconfig"
osource "/Users/sandviklee/Desktop/Repositories/sandviklee/spinsat/zephyr/soc/st/stm32/Kconfig"
osource "/Users/sandviklee/Desktop/Repositories/sandviklee/spinsat/zephyr/soc/snps/qemu_arc/Kconfig"
osource "/Users/sandviklee/Desktop/Repositories/sandviklee/spinsat/zephyr/soc/snps/nsim/arc_v/Kconfig"
osource "/Users/sandviklee/Desktop/Repositories/sandviklee/spinsat/zephyr/soc/snps/nsim/arc_classic/Kconfig"
osource "/Users/sandviklee/Desktop/Repositories/sandviklee/spinsat/zephyr/soc/snps/hsdk4xd/Kconfig"
osource "/Users/sandviklee/Desktop/Repositories/sandviklee/spinsat/zephyr/soc/snps/hsdk/Kconfig"
osource "/Users/sandviklee/Desktop/Repositories/sandviklee/spinsat/zephyr/soc/snps/emsk/Kconfig"
osource "/Users/sandviklee/Desktop/Repositories/sandviklee/spinsat/zephyr/soc/snps/emsdp/Kconfig"
osource "/Users/sandviklee/Desktop/Repositories/sandviklee/spinsat/zephyr/soc/snps/arc_iot/Kconfig"
osource "/Users/sandviklee/Desktop/Repositories/sandviklee/spinsat/zephyr/soc/silabs/Kconfig"
osource "/Users/sandviklee/Desktop/Repositories/sandviklee/spinsat/zephyr/soc/sifive/sifive_freedom/Kconfig"
osource "/Users/sandviklee/Desktop/Repositories/sandviklee/spinsat/zephyr/soc/sensry/Kconfig"
osource "/Users/sandviklee/Desktop/Repositories/sandviklee/spinsat/zephyr/soc/rockchip/Kconfig"
osource "/Users/sandviklee/Desktop/Repositories/sandviklee/spinsat/zephyr/soc/renode/riscv_virtual/Kconfig"
osource "/Users/sandviklee/Desktop/Repositories/sandviklee/spinsat/zephyr/soc/renode/cortex_r8_virtual/Kconfig"
osource "/Users/sandviklee/Desktop/Repositories/sandviklee/spinsat/zephyr/soc/renesas/smartbond/Kconfig"
osource "/Users/sandviklee/Desktop/Repositories/sandviklee/spinsat/zephyr/soc/renesas/rzt2m/Kconfig"
osource "/Users/sandviklee/Desktop/Repositories/sandviklee/spinsat/zephyr/soc/renesas/rz/Kconfig"
osource "/Users/sandviklee/Desktop/Repositories/sandviklee/spinsat/zephyr/soc/renesas/rcar/Kconfig"
osource "/Users/sandviklee/Desktop/Repositories/sandviklee/spinsat/zephyr/soc/renesas/ra/Kconfig"
osource "/Users/sandviklee/Desktop/Repositories/sandviklee/spinsat/zephyr/soc/realtek/ec/Kconfig"
osource "/Users/sandviklee/Desktop/Repositories/sandviklee/spinsat/zephyr/soc/raspberrypi/rpi_pico/Kconfig"
osource "/Users/sandviklee/Desktop/Repositories/sandviklee/spinsat/zephyr/soc/quicklogic/eos_s3/Kconfig"
osource "/Users/sandviklee/Desktop/Repositories/sandviklee/spinsat/zephyr/soc/qemu/virt_riscv/Kconfig"
osource "/Users/sandviklee/Desktop/Repositories/sandviklee/spinsat/zephyr/soc/qemu/malta/Kconfig"
osource "/Users/sandviklee/Desktop/Repositories/sandviklee/spinsat/zephyr/soc/openisa/rv32m1/Kconfig"
osource "/Users/sandviklee/Desktop/Repositories/sandviklee/spinsat/zephyr/soc/nxp/s32/Kconfig"
osource "/Users/sandviklee/Desktop/Repositories/sandviklee/spinsat/zephyr/soc/nxp/rw/Kconfig"
osource "/Users/sandviklee/Desktop/Repositories/sandviklee/spinsat/zephyr/soc/nxp/mcx/Kconfig"
osource "/Users/sandviklee/Desktop/Repositories/sandviklee/spinsat/zephyr/soc/nxp/lpc/Kconfig"
osource "/Users/sandviklee/Desktop/Repositories/sandviklee/spinsat/zephyr/soc/nxp/layerscape/Kconfig"
osource "/Users/sandviklee/Desktop/Repositories/sandviklee/spinsat/zephyr/soc/nxp/kinetis/Kconfig"
osource "/Users/sandviklee/Desktop/Repositories/sandviklee/spinsat/zephyr/soc/nxp/imxrt/Kconfig"
osource "/Users/sandviklee/Desktop/Repositories/sandviklee/spinsat/zephyr/soc/nxp/imx/Kconfig"
osource "/Users/sandviklee/Desktop/Repositories/sandviklee/spinsat/zephyr/soc/nuvoton/numicro/Kconfig"
osource "/Users/sandviklee/Desktop/Repositories/sandviklee/spinsat/zephyr/soc/nuvoton/numaker/Kconfig"
osource "/Users/sandviklee/Desktop/Repositories/sandviklee/spinsat/zephyr/soc/nuvoton/npcx/Kconfig"
osource "/Users/sandviklee/Desktop/Repositories/sandviklee/spinsat/zephyr/soc/nuvoton/npcm/Kconfig"
osource "/Users/sandviklee/Desktop/Repositories/sandviklee/spinsat/zephyr/soc/nordic/Kconfig"
osource "/Users/sandviklee/Desktop/Repositories/sandviklee/spinsat/zephyr/soc/neorv32/Kconfig"
osource "/Users/sandviklee/Desktop/Repositories/sandviklee/spinsat/zephyr/soc/native/inf_clock/Kconfig"
osource "/Users/sandviklee/Desktop/Repositories/sandviklee/spinsat/zephyr/soc/microchip/miv/Kconfig"
osource "/Users/sandviklee/Desktop/Repositories/sandviklee/spinsat/zephyr/soc/microchip/mec/Kconfig"
osource "/Users/sandviklee/Desktop/Repositories/sandviklee/spinsat/zephyr/soc/mediatek/mt8xxx/Kconfig"
osource "/Users/sandviklee/Desktop/Repositories/sandviklee/spinsat/zephyr/soc/lowrisc/opentitan/Kconfig"
osource "/Users/sandviklee/Desktop/Repositories/sandviklee/spinsat/zephyr/soc/litex/litex_vexriscv/Kconfig"
osource "/Users/sandviklee/Desktop/Repositories/sandviklee/spinsat/zephyr/soc/ite/ec/Kconfig"
osource "/Users/sandviklee/Desktop/Repositories/sandviklee/spinsat/zephyr/soc/intel/raptor_lake/Kconfig"
osource "/Users/sandviklee/Desktop/Repositories/sandviklee/spinsat/zephyr/soc/intel/lakemont/Kconfig"
osource "/Users/sandviklee/Desktop/Repositories/sandviklee/spinsat/zephyr/soc/intel/intel_socfpga_std/Kconfig"
osource "/Users/sandviklee/Desktop/Repositories/sandviklee/spinsat/zephyr/soc/intel/intel_socfpga/Kconfig"
osource "/Users/sandviklee/Desktop/Repositories/sandviklee/spinsat/zephyr/soc/intel/intel_niosv/Kconfig"
osource "/Users/sandviklee/Desktop/Repositories/sandviklee/spinsat/zephyr/soc/intel/intel_ish/Kconfig"
osource "/Users/sandviklee/Desktop/Repositories/sandviklee/spinsat/zephyr/soc/intel/intel_adsp/Kconfig"
osource "/Users/sandviklee/Desktop/Repositories/sandviklee/spinsat/zephyr/soc/intel/elkhart_lake/Kconfig"
osource "/Users/sandviklee/Desktop/Repositories/sandviklee/spinsat/zephyr/soc/intel/atom/Kconfig"
osource "/Users/sandviklee/Desktop/Repositories/sandviklee/spinsat/zephyr/soc/intel/apollo_lake/Kconfig"
osource "/Users/sandviklee/Desktop/Repositories/sandviklee/spinsat/zephyr/soc/intel/alder_lake/Kconfig"
osource "/Users/sandviklee/Desktop/Repositories/sandviklee/spinsat/zephyr/soc/infineon/cat3/Kconfig"
osource "/Users/sandviklee/Desktop/Repositories/sandviklee/spinsat/zephyr/soc/infineon/cat1b/Kconfig"
osource "/Users/sandviklee/Desktop/Repositories/sandviklee/spinsat/zephyr/soc/infineon/cat1a/Kconfig"
osource "/Users/sandviklee/Desktop/Repositories/sandviklee/spinsat/zephyr/soc/gd/gd32/Kconfig"
osource "/Users/sandviklee/Desktop/Repositories/sandviklee/spinsat/zephyr/soc/gaisler/leon3/Kconfig"
osource "/Users/sandviklee/Desktop/Repositories/sandviklee/spinsat/zephyr/soc/gaisler/gr716a/Kconfig"
osource "/Users/sandviklee/Desktop/Repositories/sandviklee/spinsat/zephyr/soc/espressif/Kconfig"
osource "/Users/sandviklee/Desktop/Repositories/sandviklee/spinsat/zephyr/soc/ene/kb1200/Kconfig"
osource "/Users/sandviklee/Desktop/Repositories/sandviklee/spinsat/zephyr/soc/efinix/sapphire/Kconfig"
osource "/Users/sandviklee/Desktop/Repositories/sandviklee/spinsat/zephyr/soc/cdns/xtensa_sample_controller/Kconfig"
osource "/Users/sandviklee/Desktop/Repositories/sandviklee/spinsat/zephyr/soc/cdns/sample_controller32/Kconfig"
osource "/Users/sandviklee/Desktop/Repositories/sandviklee/spinsat/zephyr/soc/cdns/dc233c/Kconfig"
osource "/Users/sandviklee/Desktop/Repositories/sandviklee/spinsat/zephyr/soc/brcm/bcmvk/Kconfig"
osource "/Users/sandviklee/Desktop/Repositories/sandviklee/spinsat/zephyr/soc/brcm/bcm2712/Kconfig"
osource "/Users/sandviklee/Desktop/Repositories/sandviklee/spinsat/zephyr/soc/brcm/bcm2711/Kconfig"
osource "/Users/sandviklee/Desktop/Repositories/sandviklee/spinsat/zephyr/soc/atmel/sam0/Kconfig"
osource "/Users/sandviklee/Desktop/Repositories/sandviklee/spinsat/zephyr/soc/atmel/sam/Kconfig"
osource "/Users/sandviklee/Desktop/Repositories/sandviklee/spinsat/zephyr/soc/aspeed/Kconfig"
osource "/Users/sandviklee/Desktop/Repositories/sandviklee/spinsat/zephyr/soc/arm/Kconfig"
osource "/Users/sandviklee/Desktop/Repositories/sandviklee/spinsat/zephyr/soc/arm/beetle/Kconfig"
osource "/Users/sandviklee/Desktop/Repositories/sandviklee/spinsat/zephyr/soc/antmicro/myra/Kconfig"
osource "/Users/sandviklee/Desktop/Repositories/sandviklee/spinsat/zephyr/soc/andestech/Kconfig"
osource "/Users/sandviklee/Desktop/Repositories/sandviklee/spinsat/zephyr/soc/amd/acp_6_0/Kconfig"
osource "/Users/sandviklee/Desktop/Repositories/sandviklee/spinsat/zephyr/soc/ambiq/Kconfig"
osource "/Users/sandviklee/Desktop/Repositories/sandviklee/spinsat/zephyr/soc/altr/zephyr_nios2f/Kconfig"
osource "/Users/sandviklee/Desktop/Repositories/sandviklee/spinsat/zephyr/soc/altr/qemu_nios2/Kconfig"
osource "/Users/sandviklee/Desktop/Repositories/sandviklee/spinsat/zephyr/soc/adi/max32/Kconfig"
```
