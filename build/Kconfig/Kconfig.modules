## build/Kconfig/soc/Kconfig.sysbuild
```kconfig
# Load Sysbuild SoC Kconfig descriptions.
osource "/Users/sandviklee/Desktop/Repositories/sandviklee/spinsat/zephyr/soc/xlnx/zynqmp/Kconfig.sysbuild"
osource "/Users/sandviklee/Desktop/Repositories/sandviklee/spinsat/zephyr/soc/xlnx/zynq7000/Kconfig.sysbuild"
osource "/Users/sandviklee/Desktop/Repositories/sandviklee/spinsat/zephyr/soc/xen/Kconfig.sysbuild"
osource "/Users/sandviklee/Desktop/Repositories/sandviklee/spinsat/zephyr/soc/wch/ch32v/Kconfig.sysbuild"
osource "/Users/sandviklee/Desktop/Repositories/sandviklee/spinsat/zephyr/soc/ti/simplelink/Kconfig.sysbuild"
osource "/Users/sandviklee/Desktop/Repositories/sandviklee/spinsat/zephyr/soc/ti/lm3s6965/Kconfig.sysbuild"
osource "/Users/sandviklee/Desktop/Repositories/sandviklee/spinsat/zephyr/soc/ti/k3/Kconfig.sysbuild"
osource "/Users/sandviklee/Desktop/Repositories/sandviklee/spinsat/zephyr/soc/telink/tlsr/Kconfig.sysbuild"
osource "/Users/sandviklee/Desktop/Repositories/sandviklee/spinsat/zephyr/soc/starfive/jh71xx/Kconfig.sysbuild"
osource "/Users/sandviklee/Desktop/Repositories/sandviklee/spinsat/zephyr/soc/st/stm32/Kconfig.sysbuild"
osource "/Users/sandviklee/Desktop/Repositories/sandviklee/spinsat/zephyr/soc/snps/qemu_arc/Kconfig.sysbuild"
osource "/Users/sandviklee/Desktop/Repositories/sandviklee/spinsat/zephyr/soc/snps/nsim/arc_v/Kconfig.sysbuild"
osource "/Users/sandviklee/Desktop/Repositories/sandviklee/spinsat/zephyr/soc/snps/nsim/arc_classic/Kconfig.sysbuild"
osource "/Users/sandviklee/Desktop/Repositories/sandviklee/spinsat/zephyr/soc/snps/hsdk4xd/Kconfig.sysbuild"
osource "/Users/sandviklee/Desktop/Repositories/sandviklee/spinsat/zephyr/soc/snps/hsdk/Kconfig.sysbuild"
osource "/Users/sandviklee/Desktop/Repositories/sandviklee/spinsat/zephyr/soc/snps/emsk/Kconfig.sysbuild"
osource "/Users/sandviklee/Desktop/Repositories/sandviklee/spinsat/zephyr/soc/snps/emsdp/Kconfig.sysbuild"
osource "/Users/sandviklee/Desktop/Repositories/sandviklee/spinsat/zephyr/soc/snps/arc_iot/Kconfig.sysbuild"
osource "/Users/sandviklee/Desktop/Repositories/sandviklee/spinsat/zephyr/soc/silabs/Kconfig.sysbuild"
osource "/Users/sandviklee/Desktop/Repositories/sandviklee/spinsat/zephyr/soc/sifive/sifive_freedom/Kconfig.sysbuild"
osource "/Users/sandviklee/Desktop/Repositories/sandviklee/spinsat/zephyr/soc/sensry/Kconfig.sysbuild"
osource "/Users/sandviklee/Desktop/Repositories/sandviklee/spinsat/zephyr/soc/rockchip/Kconfig.sysbuild"
osource "/Users/sandviklee/Desktop/Repositories/sandviklee/spinsat/zephyr/soc/renode/riscv_virtual/Kconfig.sysbuild"
osource "/Users/sandviklee/Desktop/Repositories/sandviklee/spinsat/zephyr/soc/renode/cortex_r8_virtual/Kconfig.sysbuild"
osource "/Users/sandviklee/Desktop/Repositories/sandviklee/spinsat/zephyr/soc/renesas/smartbond/Kconfig.sysbuild"
osource "/Users/sandviklee/Desktop/Repositories/sandviklee/spinsat/zephyr/soc/renesas/rzt2m/Kconfig.sysbuild"
osource "/Users/sandviklee/Desktop/Repositories/sandviklee/spinsat/zephyr/soc/renesas/rz/Kconfig.sysbuild"
osource "/Users/sandviklee/Desktop/Repositories/sandviklee/spinsat/zephyr/soc/renesas/rcar/Kconfig.sysbuild"
osource "/Users/sandviklee/Desktop/Repositories/sandviklee/spinsat/zephyr/soc/renesas/ra/Kconfig.sysbuild"
osource "/Users/sandviklee/Desktop/Repositories/sandviklee/spinsat/zephyr/soc/realtek/ec/Kconfig.sysbuild"
osource "/Users/sandviklee/Desktop/Repositories/sandviklee/spinsat/zephyr/soc/raspberrypi/rpi_pico/Kconfig.sysbuild"
osource "/Users/sandviklee/Desktop/Repositories/sandviklee/spinsat/zephyr/soc/quicklogic/eos_s3/Kconfig.sysbuild"
osource "/Users/sandviklee/Desktop/Repositories/sandviklee/spinsat/zephyr/soc/qemu/virt_riscv/Kconfig.sysbuild"
osource "/Users/sandviklee/Desktop/Repositories/sandviklee/spinsat/zephyr/soc/qemu/malta/Kconfig.sysbuild"
osource "/Users/sandviklee/Desktop/Repositories/sandviklee/spinsat/zephyr/soc/openisa/rv32m1/Kconfig.sysbuild"
osource "/Users/sandviklee/Desktop/Repositories/sandviklee/spinsat/zephyr/soc/nxp/s32/Kconfig.sysbuild"
osource "/Users/sandviklee/Desktop/Repositories/sandviklee/spinsat/zephyr/soc/nxp/rw/Kconfig.sysbuild"
osource "/Users/sandviklee/Desktop/Repositories/sandviklee/spinsat/zephyr/soc/nxp/mcx/Kconfig.sysbuild"
osource "/Users/sandviklee/Desktop/Repositories/sandviklee/spinsat/zephyr/soc/nxp/lpc/Kconfig.sysbuild"
osource "/Users/sandviklee/Desktop/Repositories/sandviklee/spinsat/zephyr/soc/nxp/layerscape/Kconfig.sysbuild"
osource "/Users/sandviklee/Desktop/Repositories/sandviklee/spinsat/zephyr/soc/nxp/kinetis/Kconfig.sysbuild"
osource "/Users/sandviklee/Desktop/Repositories/sandviklee/spinsat/zephyr/soc/nxp/imxrt/Kconfig.sysbuild"
osource "/Users/sandviklee/Desktop/Repositories/sandviklee/spinsat/zephyr/soc/nxp/imx/Kconfig.sysbuild"
osource "/Users/sandviklee/Desktop/Repositories/sandviklee/spinsat/zephyr/soc/nuvoton/numicro/Kconfig.sysbuild"
osource "/Users/sandviklee/Desktop/Repositories/sandviklee/spinsat/zephyr/soc/nuvoton/numaker/Kconfig.sysbuild"
osource "/Users/sandviklee/Desktop/Repositories/sandviklee/spinsat/zephyr/soc/nuvoton/npcx/Kconfig.sysbuild"
osource "/Users/sandviklee/Desktop/Repositories/sandviklee/spinsat/zephyr/soc/nuvoton/npcm/Kconfig.sysbuild"
osource "/Users/sandviklee/Desktop/Repositories/sandviklee/spinsat/zephyr/soc/nordic/Kconfig.sysbuild"
osource "/Users/sandviklee/Desktop/Repositories/sandviklee/spinsat/zephyr/soc/neorv32/Kconfig.sysbuild"
osource "/Users/sandviklee/Desktop/Repositories/sandviklee/spinsat/zephyr/soc/native/inf_clock/Kconfig.sysbuild"
osource "/Users/sandviklee/Desktop/Repositories/sandviklee/spinsat/zephyr/soc/microchip/miv/Kconfig.sysbuild"
osource "/Users/sandviklee/Desktop/Repositories/sandviklee/spinsat/zephyr/soc/microchip/mec/Kconfig.sysbuild"
osource "/Users/sandviklee/Desktop/Repositories/sandviklee/spinsat/zephyr/soc/mediatek/mt8xxx/Kconfig.sysbuild"
osource "/Users/sandviklee/Desktop/Repositories/sandviklee/spinsat/zephyr/soc/lowrisc/opentitan/Kconfig.sysbuild"
osource "/Users/sandviklee/Desktop/Repositories/sandviklee/spinsat/zephyr/soc/litex/litex_vexriscv/Kconfig.sysbuild"
osource "/Users/sandviklee/Desktop/Repositories/sandviklee/spinsat/zephyr/soc/ite/ec/Kconfig.sysbuild"
osource "/Users/sandviklee/Desktop/Repositories/sandviklee/spinsat/zephyr/soc/intel/raptor_lake/Kconfig.sysbuild"
osource "/Users/sandviklee/Desktop/Repositories/sandviklee/spinsat/zephyr/soc/intel/lakemont/Kconfig.sysbuild"
osource "/Users/sandviklee/Desktop/Repositories/sandviklee/spinsat/zephyr/soc/intel/intel_socfpga_std/Kconfig.sysbuild"
osource "/Users/sandviklee/Desktop/Repositories/sandviklee/spinsat/zephyr/soc/intel/intel_socfpga/Kconfig.sysbuild"
osource "/Users/sandviklee/Desktop/Repositories/sandviklee/spinsat/zephyr/soc/intel/intel_niosv/Kconfig.sysbuild"
osource "/Users/sandviklee/Desktop/Repositories/sandviklee/spinsat/zephyr/soc/intel/intel_ish/Kconfig.sysbuild"
osource "/Users/sandviklee/Desktop/Repositories/sandviklee/spinsat/zephyr/soc/intel/intel_adsp/Kconfig.sysbuild"
osource "/Users/sandviklee/Desktop/Repositories/sandviklee/spinsat/zephyr/soc/intel/elkhart_lake/Kconfig.sysbuild"
osource "/Users/sandviklee/Desktop/Repositories/sandviklee/spinsat/zephyr/soc/intel/atom/Kconfig.sysbuild"
osource "/Users/sandviklee/Desktop/Repositories/sandviklee/spinsat/zephyr/soc/intel/apollo_lake/Kconfig.sysbuild"
osource "/Users/sandviklee/Desktop/Repositories/sandviklee/spinsat/zephyr/soc/intel/alder_lake/Kconfig.sysbuild"
osource "/Users/sandviklee/Desktop/Repositories/sandviklee/spinsat/zephyr/soc/infineon/cat3/Kconfig.sysbuild"
osource "/Users/sandviklee/Desktop/Repositories/sandviklee/spinsat/zephyr/soc/infineon/cat1b/Kconfig.sysbuild"
osource "/Users/sandviklee/Desktop/Repositories/sandviklee/spinsat/zephyr/soc/infineon/cat1a/Kconfig.sysbuild"
osource "/Users/sandviklee/Desktop/Repositories/sandviklee/spinsat/zephyr/soc/gd/gd32/Kconfig.sysbuild"
osource "/Users/sandviklee/Desktop/Repositories/sandviklee/spinsat/zephyr/soc/gaisler/leon3/Kconfig.sysbuild"
osource "/Users/sandviklee/Desktop/Repositories/sandviklee/spinsat/zephyr/soc/gaisler/gr716a/Kconfig.sysbuild"
osource "/Users/sandviklee/Desktop/Repositories/sandviklee/spinsat/zephyr/soc/espressif/Kconfig.sysbuild"
osource "/Users/sandviklee/Desktop/Repositories/sandviklee/spinsat/zephyr/soc/ene/kb1200/Kconfig.sysbuild"
osource "/Users/sandviklee/Desktop/Repositories/sandviklee/spinsat/zephyr/soc/efinix/sapphire/Kconfig.sysbuild"
osource "/Users/sandviklee/Desktop/Repositories/sandviklee/spinsat/zephyr/soc/cdns/xtensa_sample_controller/Kconfig.sysbuild"
osource "/Users/sandviklee/Desktop/Repositories/sandviklee/spinsat/zephyr/soc/cdns/sample_controller32/Kconfig.sysbuild"
osource "/Users/sandviklee/Desktop/Repositories/sandviklee/spinsat/zephyr/soc/cdns/dc233c/Kconfig.sysbuild"
osource "/Users/sandviklee/Desktop/Repositories/sandviklee/spinsat/zephyr/soc/brcm/bcmvk/Kconfig.sysbuild"
osource "/Users/sandviklee/Desktop/Repositories/sandviklee/spinsat/zephyr/soc/brcm/bcm2712/Kconfig.sysbuild"
osource "/Users/sandviklee/Desktop/Repositories/sandviklee/spinsat/zephyr/soc/brcm/bcm2711/Kconfig.sysbuild"
osource "/Users/sandviklee/Desktop/Repositories/sandviklee/spinsat/zephyr/soc/atmel/sam0/Kconfig.sysbuild"
osource "/Users/sandviklee/Desktop/Repositories/sandviklee/spinsat/zephyr/soc/atmel/sam/Kconfig.sysbuild"
osource "/Users/sandviklee/Desktop/Repositories/sandviklee/spinsat/zephyr/soc/aspeed/Kconfig.sysbuild"
osource "/Users/sandviklee/Desktop/Repositories/sandviklee/spinsat/zephyr/soc/arm/Kconfig.sysbuild"
osource "/Users/sandviklee/Desktop/Repositories/sandviklee/spinsat/zephyr/soc/arm/beetle/Kconfig.sysbuild"
osource "/Users/sandviklee/Desktop/Repositories/sandviklee/spinsat/zephyr/soc/antmicro/myra/Kconfig.sysbuild"
osource "/Users/sandviklee/Desktop/Repositories/sandviklee/spinsat/zephyr/soc/andestech/Kconfig.sysbuild"
osource "/Users/sandviklee/Desktop/Repositories/sandviklee/spinsat/zephyr/soc/amd/acp_6_0/Kconfig.sysbuild"
osource "/Users/sandviklee/Desktop/Repositories/sandviklee/spinsat/zephyr/soc/ambiq/Kconfig.sysbuild"
osource "/Users/sandviklee/Desktop/Repositories/sandviklee/spinsat/zephyr/soc/altr/zephyr_nios2f/Kconfig.sysbuild"
osource "/Users/sandviklee/Desktop/Repositories/sandviklee/spinsat/zephyr/soc/altr/qemu_nios2/Kconfig.sysbuild"
osource "/Users/sandviklee/Desktop/Repositories/sandviklee/spinsat/zephyr/soc/adi/max32/Kconfig.sysbuild"
```

## lib/bluetooth/Kconfig
```kconfig
# Copyright (c) 2025 NTNU EiT - TTK4852
# SPDX-License-Identifier: Apache-2.0

config BLUETOOTH
	bool "Support for bluetooth library"
	help
	  This option enables the 'bluetooth' library
```

## lib/imu/Kconfig
```kconfig
# Copyright (c) 2025 NTNU EiT - TTK4852
# SPDX-License-Identifier: Apache-2.0

config IMU
    bool "Support for the IMU (LSM9DS1)"
    default n
    help
        This option enables the IMU API library for the LSM9DS1 sensor, providing
        access to gyroscope, accelerometer, and magnetometer data.

config IMU_GYRO_ODR
    int "Gyroscope output data rate (Hz)"
    depends on IMU
    default 119
    range 10 952
    help
        Sets the sampling frequency for the gyroscope in Hz. Supported values
        for the LSM9DS1 are typically 10, 20, 40, 80, 119, 238, 476, 952 Hz,
        depending on the driver configuration.

config IMU_ACCEL_ODR
    int "Accelerometer output data rate (Hz)"
    depends on IMU
    default 119
    range 10 952
    help
        Sets the sampling frequency for the accelerometer in Hz. Supported values
        for the LSM9DS1 are typically 10, 20, 40, 80, 119, 238, 476, 952 Hz,
        depending on the driver configuration.

config IMU_MAG_ODR
    int "Magnetometer output data rate (Hz)"
    depends on IMU
    default 10
    range 0 80
    help
        Sets the sampling frequency for the magnetometer in Hz. Supported values
        for the LSM9DS1 are typically 0.625, 1.25, 2.5, 5, 10, 20, 40, 80 Hz.

config IMU_CALIBRATION_SAMPLES
    int "Number of samples for IMU calibration"
    depends on IMU
    default 100
    range 10 1000
    help
        Specifies the number of samples to average during gyroscope and
        accelerometer calibration to compute offsets. Higher values improve
        accuracy but increase calibration time.
```

## lib/motor/Kconfig
```kconfig
# Copyright (c) 2025 NTNU EiT - TTK4852
# SPDX-License-Identifier: Apache-2.0

config MOTOR
	bool "Support for the motor"
	help
	  This option enables the motor library
```

## lib/state_machine/Kconfig
```kconfig
# Copyright (c) 2025 NTNU EiT - TTK4852
# SPDX-License-Identifier: Apache-2.0


config STATE_MACHINE
	bool "Support for the state machine"
	help
	  This option enables the 'custom' library


config STATE_MACHINE_START_STATE
	int "Which state the state machine should start in"
	depends on STATE_MACHINE
	default 1
	help
    This option specifies the state machine starting state for debugging purposes.
```
